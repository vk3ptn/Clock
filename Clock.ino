// Author: Phuong Nguyen (VK3PTN)
// Description: Internet clock and weather station using ESP32 2.8-inch TFT Display Module
//              Note: Most of the codes were generated by Google AI
// Version:
//  1.0.0 Initial version - 15/09/2026
//  1.0.1 Implemented basic clock - 17/09/2026
//  1.0.2 Added weather observation info - 18/09/2026
//  1.0.3 Re-arranged display format and added proper temperature symbol - 20/09/2026

#include <SPI.h>
#include <WiFi.h>
#include <HTTPClient.h>
#include <ArduinoJson.h>
#include <TFT_eSPI.h>
#include <time.h>

#define ST7789_DRIVER
#define TFT_WIDTH  240
#define TFT_HEIGHT 320

#define TFT_MISO 12
#define TFT_MOSI 13
#define TFT_SCLK 14
#define TFT_CS   15
#define TFT_DC    2
#define TFT_RST  -1
#define TFT_BL   21

// ============================================================
// WIFI SETTINGS - Enter your details here
// ============================================================
const char* WIFI_SSID     = "xxx";
const char* WIFI_PASSWORD = "xxx";

// ============================================================
// TIMEZONE - Melbourne with automatic daylight saving
// ============================================================
const char* TIMEZONE = "AEST-10AEDT,M10.1.0,M4.1.0";

// ============================================================
// WEATHER SETTINGS (Altona, VIC parameters from your template)
// ============================================================
const char* weatherURL =
  "https://api.open-meteo.com/v1/forecast"
  "?latitude=-37.8676"
  "&longitude=144.8300"
  "&current=temperature_2m,relative_humidity_2m,weather_code,wind_speed_10m,wind_direction_10m"
  "&temperature_unit=celsius"
  "&wind_speed_unit=kmh"
  "&timezone=Australia%2FMelbourne";

TFT_eSPI tft = TFT_eSPI();

// Shortened Day abbreviations array
const String daysOfWeek[7] = {"Sun", "Mon", "Tue", "Wed", "Thu", "Fri", "Sat"};

// Weather Metric Storage Containers
float currentTemp = 0.0;
int currentConditionCode = 0;
int currentHumidity = 0;
float currentWindSpeed = 0.0;
int currentWindDirection = 0;
bool weatherLoaded = false;

unsigned long lastWeatherUpdate = 0;
const unsigned long WEATHER_INTERVAL = 600000;   // 10 minutes matching your template

// Translates API codes into clear status words
String getWeatherDesc(int code) {
  if (code == 0) return " Clear";
  if (code >= 1 && code <= 3) return "Cloudy";
  if (code >= 45 && code <= 48) return " Foggy";
  if (code >= 51 && code <= 55) return "Drizzle";
  if (code >= 61 && code <= 65) return " Rain";
  if (code >= 71 && code <= 75) return " Snow";
  if (code >= 80 && code <= 82) return "Showers";
  if (code >= 95 && code <= 99) return " Storm";
  return "Stable";
}

// Converts Wind Heading angles to Cardinal directions
String getWindDirectionStr(int degrees) {
  if (degrees >= 338 || degrees < 23)  return "N";
  if (degrees >= 23  && degrees < 68)  return "NE";
  if (degrees >= 68  && degrees < 113) return "E";
  if (degrees >= 113 && degrees < 158) return "SE";
  if (degrees >= 158 && degrees < 203) return "S";
  if (degrees >= 203 && degrees < 248) return "SW";
  if (degrees >= 248 && degrees < 293) return "W";
  return "NW";
}

// Generates dynamic vector geometric weather icons directly to screen
void drawWeatherIcon(int x, int y, int code) {
  tft.fillRect(x, y, 40, 40, TFT_BLACK); // Clear icon quadrant
  
  if (code == 0) { // Clear - Sun Symbol
    tft.fillCircle(x + 20, y + 20, 10, TFT_YELLOW); // True Yellow (0xF800 for BGR panels)
    for (int i = 0; i < 360; i += 45) {
      float rad = i * 0.01745;
      tft.drawLine(x + 20 + cos(rad)*13, y + 20 + sin(rad)*13, x + 20 + cos(rad)*18, y + 20 + sin(rad)*18, TFT_YELLOW);
    }
  } 
  else if (code >= 1 && code <= 3) { // Cloudy - Stacked Clouds
    tft.fillCircle(x + 15, y + 24, 8, TFT_DARKGREY);
    tft.fillCircle(x + 25, y + 20, 10, TFT_WHITE);
    tft.fillCircle(x + 33, y + 25, 7, TFT_WHITE);
    tft.fillRect(x + 15, y + 28, 18, 5, TFT_WHITE);
  } 
  else if ((code >= 51 && code <= 65) || (code >= 80 && code <= 82)) { // Rain / Showers
    tft.fillCircle(x + 20, y + 16, 9, TFT_WHITE);
    tft.fillCircle(x + 28, y + 20, 7, TFT_WHITE);
    tft.fillCircle(x + 13, y + 20, 6, TFT_WHITE);
    tft.fillRect(x + 13, y + 22, 15, 5, TFT_WHITE);
    tft.drawLine(x + 15, y + 29, x + 12, y + 35, 0x07FF); // True Cyan (0x07FF) rain streaks
    tft.drawLine(x + 22, y + 29, x + 19, y + 35, 0x07FF);
    tft.drawLine(x + 29, y + 29, x + 26, y + 35, 0x07FF);
  } 
  else if (code >= 95 && code <= 99) { // Storm - Lightning Bolt
    tft.fillCircle(x + 20, y + 15, 9, TFT_DARKGREY);
    tft.drawLine(x + 22, y + 22, x + 14, y + 30, 0xF800);
    tft.drawLine(x + 14, y + 30, x + 20, y + 30, 0xF800);
    tft.drawLine(x + 20, y + 30, x + 15, y + 38, 0xF800);
  } 
  else { // Default / Foggy / Stable
    tft.drawFastHLine(x + 8, y + 18, 24, TFT_LIGHTGREY);
    tft.drawFastHLine(x + 5, y + 23, 30, TFT_LIGHTGREY);
    tft.drawFastHLine(x + 10, y + 28, 20, TFT_LIGHTGREY);
  }
}

void setup() {
  Serial.begin(115200);

  // Turn on display backlight matching your working configuration
  pinMode(TFT_BL, OUTPUT);
  digitalWrite(TFT_BL, LOW); 

  tft.init();
  tft.setRotation(1); // Horizontal landscape mode
  tft.invertDisplay(false);
  tft.fillScreen(TFT_BLACK);

  tft.setTextSize(1);
  tft.setTextColor(TFT_WHITE, TFT_BLACK);
  tft.drawCentreString("Connecting to WiFi...", 160, 110, 4);

  // Connect to Wi-Fi following your project template
  WiFi.begin(WIFI_SSID, WIFI_PASSWORD);
  while (WiFi.status() != WL_CONNECTED) {
    delay(500);
    Serial.print(".");
  }
  Serial.println("\nWi-Fi connected.");

  // Configure background time engine using your automatic daylight savings parameters
  configTzTime(TIMEZONE, "pool.ntp.org", "time.nist.gov");
  
  struct tm timeinfo;
  if (getLocalTime(&timeinfo, 10000)) {
    Serial.println("Time synchronized.");
  }

  tft.fillScreen(TFT_BLACK); // Wipe screen setup layers completely clean
  tft.drawFastHLine(10, 158, 300, TFT_DARKGREY); // Permanent separation line
  
  updateWeather(); // Fetch initial weather payload parameters immediately
  lastWeatherUpdate = millis();
}

void loop() {
  // Check Wi-Fi state matching your template safeguards
  if (WiFi.status() != WL_CONNECTED) {
    WiFi.reconnect();
    delay(5000);
    return;
  }

  // --- 1. RUN TIME AND DATE CALCULATIONS ---
  struct tm timeinfo;
  if (getLocalTime(&timeinfo)) {
    int rawHour = timeinfo.tm_hour;
    int minutes = timeinfo.tm_min;
    int seconds = timeinfo.tm_sec;
    
    // Calculate 12-hour AM/PM formatting blocks
    //String ampm = (rawHour >= 12) ? "PM" : "AM";
    //int hours = rawHour % 12;
    int hours = rawHour;
    //if (hours == 0) hours = 12;

    // Pad metrics out to double digits (HH:MM:SS)
    String hourStr = (hours < 10) ? "0" + String(hours) : String(hours);
    String minStr  = (minutes < 10) ? "0" + String(minutes) : String(minutes);
    String secStr  = (seconds < 10) ? "0" + String(seconds) : String(seconds);
    //String timeDisplayStr = hourStr + ":" + minStr + ":" + secStr + " " + ampm;
    String timeDisplayStr = hourStr + ":" + minStr + ":" + secStr;

    // Format Date line elements: "Day DD/MM/YYYY"
    int dayOfWeekNum = timeinfo.tm_wday;
    int dayOfMonth   = timeinfo.tm_mday;
    int monthNum     = timeinfo.tm_mon + 1;
    int year         = timeinfo.tm_year + 1900;

    String dayStr   = (dayOfMonth < 10) ? "0" + String(dayOfMonth) : String(dayOfMonth);
    String monthStr = (monthNum < 10) ? "0" + String(monthNum) : String(monthNum);
    String dateDisplayStr = daysOfWeek[dayOfWeekNum] + " " + dayStr + "/" + monthStr + "/" + String(year);

    // --- 2. RENDER TIME AND DATE LAYERS TO LANDSCAPE DISK ARRAY ---
    tft.setTextColor(0x07FF, TFT_BLACK); // True Cyan color mapping code 0x07FF
    tft.drawCentreString(timeDisplayStr + " ", 160, 30, 7); 

    tft.setTextColor(TFT_WHITE, TFT_BLACK);
    tft.drawCentreString(dateDisplayStr + " ", 160, 110, 4); 
  }

  // --- 3. SCHEDULED BACKGROUND WEATHER REFRESH ---
  unsigned long now = millis();
  if (now - lastWeatherUpdate >= WEATHER_INTERVAL) {
    lastWeatherUpdate = now;
    updateWeather();
  }

  // --- 4. RENDER DYNAMIC WEATHER BOTTOM ROW BAR ---
  if (weatherLoaded) {
    drawWeatherIcon(12, 175, currentConditionCode);

    tft.setTextColor(TFT_YELLOW, TFT_BLACK);
    //tft.drawString(String(currentTemp, 1) + " C", 65, 172, 4); 
    tft.drawString(String(currentTemp, 1), 65, 172, 4);
    int textWidth = String(currentTemp).length() * 10;
    int circleX = 65 + textWidth + 4; // Shift right past the text
    int circleY = 172 + 4;     
    tft.drawCircle(circleX, circleY, 3, TFT_YELLOW); // 3-pixel radius circle
    tft.drawString("C", circleX + 8, 172, 4);       // Shift down slightly to sit high
    
    tft.setTextColor(TFT_GREEN, TFT_BLACK);
    tft.drawString(getWeatherDesc(currentConditionCode) + "    ", 65, 202, 4);

    tft.setTextColor(TFT_BLUE, TFT_BLACK);
    tft.drawString(String(currentHumidity) + "% RH", 165, 175, 4);

    tft.setTextColor(TFT_RED, TFT_BLACK);    
    String windStr = String(currentWindSpeed, 0) + " Km/h " + getWindDirectionStr(currentWindDirection);
    tft.drawString(windStr, 165, 200, 4);
  } else {
    tft.setTextColor(TFT_WHITE, TFT_BLACK);
    tft.drawCentreString("Loading observations...", 160, 190, 2);
  }

  delay(200); // 5 loop ticks per second drives smooth ticking seconds updates
}

// Fixed, secure weather fetching function matching your original connection method
void updateWeather() {
  HTTPClient http;
  
  Serial.println("\n--- Syncing Weather Metrics ---");
  // Utilises HTTPClient's auto-managed background transport layer like your project template
  http.begin(weatherURL);
  int httpCode = http.GET();

  if (httpCode == HTTP_CODE_OK) {
    String payload = http.getString();
    JsonDocument doc;
    DeserializationError error = deserializeJson(doc, payload);

    if (!error) {
      // Direct variable field maps pointing to Open-Meteo current JSON attributes
      currentTemp           = doc["current"]["temperature_2m"] | 0.0;
      currentConditionCode  = doc["current"]["weather_code"] | 0;
      currentHumidity       = doc["current"]["relative_humidity_2m"] | 0;
      currentWindSpeed      = doc["current"]["wind_speed_10m"] | 0.0;
      currentWindDirection  = doc["current"]["wind_direction_10m"] | 0;
      
      weatherLoaded = true;
      Serial.println(">>> Weather metrics loaded successfully! <<<");
    } else {
      Serial.print("JSON Parse error: ");
      Serial.println(error.c_str());
    }
  } else {
    Serial.print("HTTP Connection Failure, code: ");
    Serial.println(httpCode);
  }
  http.end();
}